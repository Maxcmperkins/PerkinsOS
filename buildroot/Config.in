## buildroot/package/perkinsos-compositor/Config.in
```kconfig
config BR2_PACKAGE_PERKINSOS_COMPOSITOR
	bool "perkinsos-compositor"
	depends on BR2_PACKAGE_WLROOTS
	help
	  The PerkinsOS Wayland compositor, built from the compositor/
	  folder at the top of this repository. Installed as
	  /usr/bin/perkinsos-compositor.

comment "perkinsos-compositor needs wlroots"
	depends on !BR2_PACKAGE_WLROOTS
```

## buildroot/package/perkinsos-shell/Config.in
```kconfig
config BR2_PACKAGE_PERKINSOS_SHELL
	bool "perkinsos-shell"
	depends on BR2_PACKAGE_WLROOTS # layer-shell protocol XML
	select BR2_PACKAGE_WAYLAND
	select BR2_PACKAGE_WAYLAND_PROTOCOLS
	select BR2_PACKAGE_LIBXKBCOMMON
	select BR2_PACKAGE_CAIRO
	select BR2_PACKAGE_CAIRO_PNG
	help
	  The PerkinsOS dock, launcher and apps, built from the shell/
	  folder at the top of this repository. Every folder shell/NAME/
	  becomes the program /usr/bin/perkinsos-NAME.

comment "perkinsos-shell needs wlroots"
	depends on !BR2_PACKAGE_WLROOTS
```

## buildroot/package/tinywl/Config.in
```kconfig
config BR2_PACKAGE_TINYWL
	bool "tinywl"
	depends on BR2_PACKAGE_WLROOTS
	help
	  TinyWL, the ~1000-line reference compositor that ships inside
	  the wlroots source tree. Built unmodified, from the same
	  wlroots version as the library, as the starting point for the
	  PerkinsOS compositor.

	  https://gitlab.freedesktop.org/wlroots/wlroots/-/tree/master/tinywl

comment "tinywl needs wlroots"
	depends on !BR2_PACKAGE_WLROOTS
```
